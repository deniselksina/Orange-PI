/dts-v1/;

/ {
    compatible = "allwinner,sun4i-a10";
    fragment@0 {
        target = <&spi>;
        __overlay__ {
            touchscreen@0 {
                compatible = "ti,tsc2046";
                reg = <0>;
                interrupt-parent = <&gpio>;
                interrupt = <0 2 0>;
                spi-max-frequency = <1000000>;
                touchscreen-size-x = <800>;
                touchscreen-size-y = <480>;
            };
        };
    };
};
