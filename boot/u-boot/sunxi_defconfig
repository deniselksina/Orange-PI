## boot/u-boot/sunxi_defconfig
```kconfig
# Конфигурация для U-Boot для платформы с чипом Allwinner H3 (например, Orange PI PC)

CONFIG_ARCH_SUNXI=y                  # Использование архитектуры Sunxi (Allwinner)
CONFIG_TARGET_SUNXI=y                # Установка цели на платформу Sunxi
CONFIG_SYS_MALLOC_F="16MiB"          # Установка размера памяти для malloc
CONFIG_CMD_USB=y                     # Включение поддержки USB
CONFIG_CMD_NET=y                     # Включение сетевой загрузки
CONFIG_CMD_MMC=y                     # Включение поддержки MMC/SD
CONFIG_SPL=y                          # Включение SPL (Secondary Program Loader)
CONFIG_SPL_OS_BOOT=y                 # Включение загрузки ОС в SPL

# Определение типов памяти
CONFIG_SYS_MEMTEST_START=0x40000000  # Стартовая адресация для теста памяти
CONFIG_SYS_MEMTEST_END=0x44000000    # Конечная адресация для теста памяти

# Параметры загрузки и конфигурации
CONFIG_BOOTDELAY=3                   # Время ожидания перед загрузкой
CONFIG_BOOTCOMMAND="run bootcmd_mmc"  # Команда по умолчанию для загрузки с MMC
CONFIG_BOOTARGS="console=ttyS0,115200 root=/dev/mmcblk0p2 rootwait"  # Аргументы ядра

# Установка конфигурации сетевого интерфейса
CONFIG_NET_MULTI=y                   # Включение поддержки нескольких сетевых интерфейсов
CONFIG_ETHADDR=00:14:22:01:02:03     # MAC-адрес сетевого интерфейса

# Сетевые настройки (например, для загрузки через TFTP)
CONFIG_CMD_DHCP=y                    # Включение DHCP
CONFIG_NET_TFTP=y                    # Включение поддержки TFTP
```

## build/armbian/config/board/orangepi/uboot/config/custom_defconfig
```kconfig
# Настройки U-Boot для Orange PI с пользовательскими изменениями
CONFIG_ARCH_SUNXI=y
CONFIG_ARM=y
CONFIG_MACH_SUN6I=y
CONFIG_MACH_ORANGE_PI_PC=y
CONFIG_SPL=y
CONFIG_CMD_GPIO=y
CONFIG_CMD_SPI=y                # Добавлена поддержка SPI
CONFIG_CMD_I2C=y                # Добавлена поддержка I2C
CONFIG_CMD_EXT4=y               # Поддержка EXT4
CONFIG_SYS_BOOTM_LEN=0x3000000  # Увеличен размер памяти для загрузки
CONFIG_ENV_SIZE=0x10000         # Размер среды
```

## build/armbian/config/board/orangepi/uboot/config/orange-pi-pc_defconfig
```kconfig
# Конфигурация U-Boot для Orange PI PC
CONFIG_ARCH_SUNXI=y
CONFIG_ARM=y
CONFIG_MACH_SUN6I=y
CONFIG_MACH_ORANGE_PI_PC=y
CONFIG_SPL=y
CONFIG_CMD_GPIO=y
CONFIG_CMD_BOOTZ=y
CONFIG_CMD_FAT=y
CONFIG_FAT_WRITE=y
CONFIG_CMD_USB=y
CONFIG_CMD_MMC=y
CONFIG_USB_EHCI_HCD=y
CONFIG_USB_STORAGE=y
CONFIG_CMD_SF=y
CONFIG_CMD_NET=y
CONFIG_CMD_TFTPPUT=y
CONFIG_CMD_DHCP=y
CONFIG_ENV_OVERWRITE=y
CONFIG_SYS_BOOTM_LEN=0x2000000
```

## build/armbian/config/uboot/config/uboot_defconfig
```kconfig
CONFIG_ARM=y
CONFIG_ARCH_SUN7I=y
CONFIG_SYS_THUMB_BUILD=y
CONFIG_CMD_MMC=y
CONFIG_CMD_FAT=y
CONFIG_CMD_EXT4=y
CONFIG_SPL=y
```

## build/armbian/source/kernel/linux-5.10.y/config/defconfig
```kconfig
# Генерация конфигурации для ядра на базе defconfig
CONFIG_ARCH=arm
CONFIG_ARM=y
CONFIG_OMAP=y
CONFIG_CPU_ARMV7=y
CONFIG_MMU=y
CONFIG_BLK_DEV_SD=y
CONFIG_NETDEVICES=y
CONFIG_USB=y
CONFIG_USB_EHCI_HCD=y
# Прочие стандартные параметры...
```

## build/boyjack-os/kernel/defconfig
```kconfig
# CONFIG_ARM64=y
# CONFIG_DEBUG_KERNEL=y
# CONFIG_USB_SUPPORT=y
CONFIG_USB_EHCI_HCD=y
CONFIG_USB_STORAGE=y
# CONFIG_NETFILTER=y
CONFIG_SCSI=y
# CONFIG_IPV6=y
```
